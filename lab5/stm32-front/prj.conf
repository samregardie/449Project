## CMakeLists.txt
```
cmake_minimum_required(VERSION 3.20.0)
find_package(Zephyr REQUIRED HINTS $ENV{ZEPHYR_BASE})
project(stm32_front)

# N2, the steering zone
target_compile_definitions(app PRIVATE NODE_ID=2)

set(COMMON ${CMAKE_CURRENT_SOURCE_DIR}/../stm32-common)

target_sources(app PRIVATE src/main.c src/servo.c ${COMMON}/src/canbus.c ${COMMON}/src/relay.c
	${COMMON}/src/ctrl.c ${COMMON}/src/errorstate.c ${COMMON}/src/blinker.c)
target_include_directories(app PRIVATE include ${COMMON}/include)
```

## prj.conf
```kconfig
CONFIG_GPIO=y
CONFIG_PWM=y
CONFIG_CAN=y
CONFIG_CRC=y
CONFIG_WATCHDOG=y

# Debug: print the reset cause at boot (was it the watchdog?)
CONFIG_HWINFO=y

# main does init, then FORCE_TX: the lowest priority, below every other thread
CONFIG_MAIN_THREAD_PRIORITY=10
```

## include/servo.h
```c
#ifndef SERVO_H
#define SERVO_H

#include <stdbool.h>
#include <stdint.h>

/* Steering: -100 = full left, 0 = centre, 100 = full right */
#define SERVO_STEER_MAX 100

/*
 * pulse = CENTRE + RANGE * steering / 100, in us.
 * CENTRE: wheels straight. RANGE: centre to full lock
 */
#define SERVO_PULSE_CENTRE_US 1500
#define SERVO_PULSE_RANGE_US 700

/* Outputs centre; starts in the error state */
int servo_init(void);

/* Clamped to -100..100; ignored in the error state. ISR-safe. */
void servo_command(int32_t steering);

/* true = hold the current position and ignore commands */
void servo_set_error(bool error);

#endif
```

## src/servo.c
```c
/*
 * Steering servo, 50 Hz PWM. The timer repeats the pulse by itself, so no
 * thread is needed. A new width starts at the next period (<= 20 ms).
 */

#include <zephyr/kernel.h>
#include <zephyr/drivers/pwm.h>

#include "servo.h"

static const struct pwm_dt_spec servo = PWM_DT_SPEC_GET_BY_NAME(DT_PATH(zephyr_user), servo);

/* Also set from the test-button ISR (via errorstate), so under the lock */
static struct k_spinlock lock;
static bool error = true;	/* power-up is the error state */

/* Clamping the input keeps the pulse within CENTRE +/- RANGE */
static void write_steering(int32_t steering)
{
	steering = CLAMP(steering, -SERVO_STEER_MAX, SERVO_STEER_MAX);

	int32_t us = SERVO_PULSE_CENTRE_US +
		     SERVO_PULSE_RANGE_US * steering / SERVO_STEER_MAX;

	/* Only register writes, so fine under a spinlock */
	pwm_set_pulse_dt(&servo, PWM_USEC(us));
}

int servo_init(void)
{
	if (!pwm_is_ready_dt(&servo)) {
		return -ENODEV;
	}

	k_spinlock_key_t key = k_spin_lock(&lock);

	write_steering(0);

	k_spin_unlock(&lock, key);
	return 0;
}

void servo_command(int32_t steering)
{
	k_spinlock_key_t key = k_spin_lock(&lock);

	if (!error) {
		write_steering(steering);
	}

	k_spin_unlock(&lock, key);
}

void servo_set_error(bool new_error)
{
	k_spinlock_key_t key = k_spin_lock(&lock);

	error = new_error;

	k_spin_unlock(&lock, key);
}
```
